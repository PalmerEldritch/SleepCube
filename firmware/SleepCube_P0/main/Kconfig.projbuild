## firmware/control/main/Kconfig.projbuild
```kconfig
menu "SleepCube R01 Control Configuration"

choice SC_BOARD_PROFILE
    prompt "Board profile"
    default SC_BOARD_WAVESHARE_ESP32C6
    help
        Select the hardware profile used for this build.

    config SC_BOARD_DEVKITC_ESP32
        bool "ESP32 DevKitC (bring-up board)"

    config SC_BOARD_WAVESHARE_ESP32C6
        bool "Waveshare ESP32-C6 touch display board"
endchoice

config SC_REMOTE_PLAY_DURATION_SECONDS
    int "Remote playback session duration (seconds)"
    range 1 3600
    default 3600
    help
        Finite session duration sent with normal product PLAY requests. R00
        production builds use 3600 seconds. Shorter values may be selected in
        temporary verification builds without changing the wire contract.

config SC_ENABLE_SEMANTIC_CONSOLE
    bool "Enable development semantic-audio console"
    default n
    help
        Enables the single-character USB development console used during M4
        protocol bring-up. Keep this disabled in product, timing and endurance
        images: arbitrary host input must never issue audio commands.

config SC_ENABLE_LIGHT_DEBUG_CONSOLE
    bool "Enable development COB PWM console"
    depends on SC_ENABLE_LIGHT && !SC_ENABLE_SEMANTIC_CONSOLE
    default n
    help
        Enables line-oriented USB development commands for runtime COB PWM
        frequency and exact-duty experiments. This bypasses the normal light
        presentation while manual duty override is active and must remain
        disabled in a release image.

config SC_ENABLE_TOUCH_DEBUG_MODE
    bool "Enable touch-screen hardware debug mode"
    depends on SC_ENABLE_LIGHT && SC_ENABLE_UI && SC_UI_BACKEND_LCD_TOUCH
    default n
    help
        Adds the five-tap 2x4 touch debug grid and matched semantic audio
        source controls. Development images only; keep disabled in releases.

config SC_ENABLE_LIGHT
    bool "Enable lighting service"
    default y

config SC_ENABLE_UI
    bool "Enable UI service"
    default y

config SC_TRACE_TIMING
    bool "Enable runtime timing trace logs"
    default n
    help
        Emits structured timing markers from key tasks (app core, audio, light, UI)
        that can be post-processed into scheduling diagrams.

config SC_LIGHT_PWM_GPIO
    int "COB MOSFET PWM GPIO"
    depends on SC_ENABLE_LIGHT
    range 0 39
    default 8 if SC_BOARD_WAVESHARE_ESP32C6
    default 13
    help
        Active-high logic-level MOSFET gate output. The R01 Waveshare
        hardware uses GPIO8 and requires an external gate pull-down.

config SC_LIGHT_PWM_FREQUENCY_HZ
    int "COB PWM carrier frequency (Hz)"
    depends on SC_ENABLE_LIGHT
    range 100 25000
    default 3000
    help
        Hardware PWM carrier frequency. R01 starts at 3 kHz; later hardware
        evidence may justify retuning this value.

config SC_LIGHT_PWM_MIN_DUTY_PCT
    int "Minimum active COB PWM duty percent"
    depends on SC_ENABLE_LIGHT
    range 0 100
    default 5
    help
        A brightness selection of zero remains fully off. Logical brightness
        from 1 to 100 percent maps linearly from this floor to the configured
        maximum duty. Startup and shutdown ramps may pass below the floor.

config SC_LIGHT_PWM_MAX_DUTY_PCT
    int "Maximum COB PWM duty percent"
    depends on SC_ENABLE_LIGHT
    range 1 100
    default 80
    help
        Caps the physical PWM output after ambient and audio-state effects.
        Runtime initialization fails safe when the minimum exceeds this value.

config SC_LIGHT_DEFAULT_BRIGHTNESS_PCT
    int "Default light brightness percent"
    depends on SC_ENABLE_LIGHT
    range 0 100
    default 30

config SC_LIGHT_UPDATE_HZ
    int "Light update rate (Hz)"
    depends on SC_ENABLE_LIGHT
    range 5 200
    default 50

config SC_LIGHT_STARTUP_RAMP_MS
    int "Startup ramp duration (ms)"
    depends on SC_ENABLE_LIGHT
    range 200 10000
    default 3000

config SC_LIGHT_STARTUP_OVERSHOOT_PCT
    int "Startup overshoot amount (percent)"
    depends on SC_ENABLE_LIGHT
    range 0 20
    default 6

config SC_LIGHT_FLUCT_ENABLE
    bool "Enable gentle ambient fluctuation"
    depends on SC_ENABLE_LIGHT
    default y

config SC_LIGHT_FLUCT_BRIGHTNESS_PCT
    int "Ambient fluctuation brightness amplitude (percent)"
    depends on SC_LIGHT_FLUCT_ENABLE
    range 0 20
    default 6

config SC_LIGHT_AMBIENT_SPEED_PCT
    int "Ambient fluctuation speed (percent)"
    depends on SC_LIGHT_FLUCT_ENABLE
    range 10 300
    default 100
    help
        Scales time evolution of global ambient fluctuation.
        Lower values produce slower changes.

config SC_LIGHT_AUDIO_SWAY_ENABLE
    bool "Enable audio on/off light sway"
    depends on SC_ENABLE_LIGHT
    default y

config SC_UI_BACKEND_LCD_TOUCH
    bool "Enable LCD + touch backend"
    depends on SC_ENABLE_UI && SC_BOARD_WAVESHARE_ESP32C6
    default y
    help
        This backend is tied to the Waveshare ESP32-C6 board. It is hidden
        on other board profiles to avoid conflicting hardware assumptions.

config SC_UI_INPUT_BUTTONS
    bool "Enable GPIO button input backend"
    depends on SC_ENABLE_UI
    default y if SC_BOARD_DEVKITC_ESP32
    default n if SC_BOARD_WAVESHARE_ESP32C6

config SC_BTN_AUDIO_GPIO
    int "Audio button GPIO (single press toggle)"
    depends on SC_UI_INPUT_BUTTONS
    range 0 39
    default 0

config SC_BTN_LIGHT_GPIO
    int "Legacy light button GPIO"
    depends on SC_UI_INPUT_BUTTONS
    range 0 39
    default 32

config SC_BTN_VOL_UP_GPIO
    int "Volume up button GPIO"
    depends on SC_UI_INPUT_BUTTONS
    range 0 39
    default 33

config SC_BTN_VOL_DOWN_GPIO
    int "Volume down button GPIO"
    depends on SC_UI_INPUT_BUTTONS
    range 0 39
    default 21

config SC_BTN_LIGHT_UP_GPIO
    int "Brightness up button GPIO"
    depends on SC_UI_INPUT_BUTTONS
    range 0 39
    default 19

config SC_BTN_LIGHT_DOWN_GPIO
    int "Brightness down button GPIO"
    depends on SC_UI_INPUT_BUTTONS
    range 0 39
    default 18

endmenu
```
