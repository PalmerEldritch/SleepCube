## firmware/SleepCube_P0/main/Kconfig.projbuild
```kconfig
menu "SleepCube P0 Configuration"

choice SC_BOARD_PROFILE
    prompt "Board profile"
    default SC_BOARD_WAVESHARE_ESP32C6
    help
        Select the hardware profile used for this build.

    config SC_BOARD_DEVKITC_ESP32
        bool "ESP32 DevKitC (bring-up board)"

    config SC_BOARD_WAVESHARE_ESP32C6
        bool "Waveshare ESP32-C6 touch display board"
endchoice

config SC_ENABLE_AUDIO
    bool "Enable audio service"
    default y

choice SC_AUDIO_I2S_MODE
    prompt "Audio TX bus mode"
    depends on SC_ENABLE_AUDIO
    default SC_AUDIO_I2S_MODE_STD
    help
        Select the digital audio bus mode used by the amplifier TX path.
        Standard I2S sends two stereo slots per frame. 8-slot TDM sends
        eight slots per frame for amplifiers configured for TDM input.

    config SC_AUDIO_I2S_MODE_STD
        bool "Standard I2S stereo"

    config SC_AUDIO_I2S_MODE_TDM8
        bool "8-slot TDM"
        depends on SOC_I2S_SUPPORTS_TDM
endchoice

choice SC_AUDIO_I2S_FRAMING
    prompt "Audio I2S framing"
    depends on SC_ENABLE_AUDIO
    default SC_AUDIO_I2S_FRAMING_MSB
    help
        Select the framing used for audio TX. Philips I2S shifts sample data
        one bit after the word-select edge, while MSB starts sample data at
        the word-select edge.

    config SC_AUDIO_I2S_FRAMING_PHILIPS
        bool "Philips I2S"

    config SC_AUDIO_I2S_FRAMING_MSB
        bool "MSB / left-justified"
endchoice

config SC_AUDIO_HPF_CUTOFF_HZ
    int "Audio high-pass filter cutoff (Hz)"
    depends on SC_ENABLE_AUDIO
    range 0 2000
    default 150
    help
        Software high-pass filter cutoff applied to decoded PCM before I2S
        playback. Set to 0 to disable the filter.

config SC_AUDIO_HPF_STAGES
    int "Audio high-pass filter stages"
    depends on SC_ENABLE_AUDIO
    range 1 4
    default 2
    help
        Number of cascaded first-order high-pass stages. Higher values produce
        a steeper low-frequency roll-off and make the filter effect more
        noticeable on small speakers.

choice SC_AUDIO_SOURCE_MODE
    prompt "Audio source mode"
    depends on SC_ENABLE_AUDIO
    default SC_AUDIO_SOURCE_MP3

    config SC_AUDIO_SOURCE_MP3
        bool "MP3 file playback"

    config SC_AUDIO_SOURCE_DIAGNOSTIC
        bool "Diagnostic tone generator"
endchoice

choice SC_AUDIO_DIAG_SIGNAL
    prompt "Diagnostic signal"
    depends on SC_ENABLE_AUDIO && SC_AUDIO_SOURCE_DIAGNOSTIC
    default SC_AUDIO_DIAG_SIGNAL_500HZ

    config SC_AUDIO_DIAG_SIGNAL_100HZ
        bool "100 Hz sine"

    config SC_AUDIO_DIAG_SIGNAL_200HZ
        bool "200 Hz sine"

    config SC_AUDIO_DIAG_SIGNAL_500HZ
        bool "500 Hz sine"

    config SC_AUDIO_DIAG_SIGNAL_1000HZ
        bool "1 kHz sine"

    config SC_AUDIO_DIAG_SIGNAL_SWEEP
        bool "Slow frequency sweep"
endchoice

config SC_AUDIO_DIAG_AMPLITUDE_PCT
    int "Diagnostic signal amplitude percent"
    depends on SC_ENABLE_AUDIO && SC_AUDIO_SOURCE_DIAGNOSTIC
    range 1 100
    default 18
    help
        Raw generated signal amplitude before normal volume and fade control
        are applied.

config SC_AUDIO_DIAG_SWEEP_START_HZ
    int "Sweep start frequency (Hz)"
    depends on SC_ENABLE_AUDIO && SC_AUDIO_SOURCE_DIAGNOSTIC && SC_AUDIO_DIAG_SIGNAL_SWEEP
    range 20 5000
    default 80

config SC_AUDIO_DIAG_SWEEP_END_HZ
    int "Sweep end frequency (Hz)"
    depends on SC_ENABLE_AUDIO && SC_AUDIO_SOURCE_DIAGNOSTIC && SC_AUDIO_DIAG_SIGNAL_SWEEP
    range 20 8000
    default 1500

config SC_AUDIO_DIAG_SWEEP_PERIOD_MS
    int "Sweep period (ms)"
    depends on SC_ENABLE_AUDIO && SC_AUDIO_SOURCE_DIAGNOSTIC && SC_AUDIO_DIAG_SIGNAL_SWEEP
    range 500 20000
    default 5000

config SC_AUDIO_DIAG_SERIAL_CONSOLE
    bool "Enable audio diagnostic serial console"
    depends on SC_ENABLE_AUDIO
    default y
    help
        Enables a development-only serial command task for live tuning of audio
        diagnostics and playback parameters. This is intended for bring-up and
        will be removed from the final product.

config SC_ENABLE_LIGHT
    bool "Enable lighting service"
    default y

config SC_ENABLE_UI
    bool "Enable UI service"
    default y

config SC_TRACE_TIMING
    bool "Enable runtime timing trace logs"
    default n
    help
        Emits structured timing markers from key tasks (app core, audio, light, UI)
        that can be post-processed into scheduling diagrams.

config SC_LIGHT_BACKEND_LED_STRIP
    bool "Enable addressable LED strip backend"
    depends on SC_ENABLE_LIGHT
    default y

config SC_LED_STRIP_GPIO
    int "LED strip data GPIO"
    depends on SC_LIGHT_BACKEND_LED_STRIP
    range 0 39
    default 8 if SC_BOARD_WAVESHARE_ESP32C6
    default 13

config SC_LED_COUNT
    int "LED count"
    depends on SC_LIGHT_BACKEND_LED_STRIP
    range 1 300
    default 28

choice SC_LED_PIXEL_ORDER
    prompt "LED pixel order"
    depends on SC_LIGHT_BACKEND_LED_STRIP
    default SC_LED_PIXEL_ORDER_GRB

    config SC_LED_PIXEL_ORDER_GRB
        bool "GRB (common for WS2812)"

    config SC_LED_PIXEL_ORDER_RGB
        bool "RGB"
endchoice

config SC_LED_MAX_BRIGHTNESS_PCT
    int "Maximum LED brightness percent"
    depends on SC_LIGHT_BACKEND_LED_STRIP
    range 1 100
    default 60

config SC_LIGHT_DEFAULT_BRIGHTNESS_PCT
    int "Default light brightness percent"
    depends on SC_LIGHT_BACKEND_LED_STRIP
    range 1 100
    default 30

config SC_LIGHT_UPDATE_HZ
    int "Light update rate (Hz)"
    depends on SC_LIGHT_BACKEND_LED_STRIP
    range 5 200
    default 50

config SC_LIGHT_RAMP_STEP_PCT
    int "Light ramp step percent per tick"
    depends on SC_LIGHT_BACKEND_LED_STRIP
    range 1 20
    default 2

config SC_LIGHT_STARTUP_RAMP_MS
    int "Startup ramp duration (ms)"
    depends on SC_LIGHT_BACKEND_LED_STRIP
    range 200 10000
    default 3000

config SC_LIGHT_STARTUP_OVERSHOOT_PCT
    int "Startup overshoot amount (percent)"
    depends on SC_LIGHT_BACKEND_LED_STRIP
    range 0 20
    default 6

config SC_LIGHT_FLUCT_ENABLE
    bool "Enable gentle ambient fluctuation"
    depends on SC_LIGHT_BACKEND_LED_STRIP
    default y

config SC_LIGHT_FLUCT_BRIGHTNESS_PCT
    int "Ambient fluctuation brightness amplitude (percent)"
    depends on SC_LIGHT_FLUCT_ENABLE
    range 0 20
    default 6

config SC_LIGHT_FLUCT_WARMTH_PCT
    int "Ambient fluctuation warmth amplitude (percent)"
    depends on SC_LIGHT_FLUCT_ENABLE
    range 0 30
    default 10

config SC_LIGHT_AMBIENT_SPEED_PCT
    int "Ambient fluctuation speed (percent)"
    depends on SC_LIGHT_FLUCT_ENABLE
    range 10 300
    default 100
    help
        Scales time evolution of global ambient fluctuation.
        Lower values produce slower changes.

config SC_LIGHT_SPATIAL_UNDULATION_ENABLE
    bool "Enable spatial undulation along LED strip"
    depends on SC_LIGHT_BACKEND_LED_STRIP
    default y
    help
        Adds a smooth position-dependent modulation so adjacent LEDs vary together
        with interpolation between moving control points.

config SC_LIGHT_SPATIAL_UNDULATION_PCT
    int "Spatial undulation amplitude (percent)"
    depends on SC_LIGHT_SPATIAL_UNDULATION_ENABLE
    range 0 40
    default 12

config SC_LIGHT_SPATIAL_KNOTS
    int "Spatial undulation control points"
    depends on SC_LIGHT_SPATIAL_UNDULATION_ENABLE
    range 2 8
    default 4

config SC_LIGHT_SPATIAL_SPEED_PCT
    int "Spatial undulation speed (percent)"
    depends on SC_LIGHT_SPATIAL_UNDULATION_ENABLE
    range 10 300
    default 70
    help
        Scales time evolution of spatial knot movement.
        Lower values produce slower and calmer strip movement.

config SC_LIGHT_AUDIO_SWAY_ENABLE
    bool "Enable audio on/off light sway"
    depends on SC_LIGHT_BACKEND_LED_STRIP
    default y

config SC_LIGHT_AUDIO_SWAY_PCT
    int "Audio sway amplitude (percent)"
    depends on SC_LIGHT_AUDIO_SWAY_ENABLE
    range 0 100
    default 8

config SC_LIGHT_AUDIO_SWAY_MS
    int "Audio sway duration (ms)"
    depends on SC_LIGHT_AUDIO_SWAY_ENABLE
    range 100 4000
    default 1400

config SC_LIGHT_WARM_R
    int "Warm white R component"
    depends on SC_LIGHT_BACKEND_LED_STRIP
    range 0 255
    default 255

config SC_LIGHT_WARM_G
    int "Warm white G component"
    depends on SC_LIGHT_BACKEND_LED_STRIP
    range 0 255
    default 170

config SC_LIGHT_WARM_B
    int "Warm white B component"
    depends on SC_LIGHT_BACKEND_LED_STRIP
    range 0 255
    default 90

config SC_UI_BACKEND_LCD_TOUCH
    bool "Enable LCD + touch backend"
    depends on SC_ENABLE_UI && SC_BOARD_WAVESHARE_ESP32C6
    default y
    help
        This backend is tied to the Waveshare ESP32-C6 board. It is hidden
        on other board profiles to avoid conflicting hardware assumptions.

config SC_UI_INPUT_BUTTONS
    bool "Enable GPIO button input backend"
    depends on SC_ENABLE_UI
    default y if SC_BOARD_DEVKITC_ESP32
    default n if SC_BOARD_WAVESHARE_ESP32C6

config SC_BTN_AUDIO_GPIO
    int "Audio button GPIO (single press toggle)"
    depends on SC_UI_INPUT_BUTTONS
    range 0 39
    default 0

config SC_BTN_LIGHT_GPIO
    int "Legacy light button GPIO"
    depends on SC_UI_INPUT_BUTTONS
    range 0 39
    default 32

config SC_BTN_VOL_UP_GPIO
    int "Volume up button GPIO"
    depends on SC_UI_INPUT_BUTTONS
    range 0 39
    default 33

config SC_BTN_VOL_DOWN_GPIO
    int "Volume down button GPIO"
    depends on SC_UI_INPUT_BUTTONS
    range 0 39
    default 21

config SC_BTN_LIGHT_UP_GPIO
    int "Brightness up button GPIO"
    depends on SC_UI_INPUT_BUTTONS
    range 0 39
    default 19

config SC_BTN_LIGHT_DOWN_GPIO
    int "Brightness down button GPIO"
    depends on SC_UI_INPUT_BUTTONS
    range 0 39
    default 18

config SC_LOOPBACK_ENABLE
    bool "Enable I2S loopback monitor"
    depends on SC_ENABLE_AUDIO
    default y if SC_BOARD_DEVKITC_ESP32
    default n if SC_BOARD_WAVESHARE_ESP32C6
    help
        Enable digital I2S loopback monitoring for bring-up with jumper wires
        from TX pins to RX pins as documented in board_pins.h.

endmenu
```

## firmware/SleepCube_P0/sdkconfig.defaults
```kconfig
CONFIG_PARTITION_TABLE_CUSTOM=y
# CONFIG_PARTITION_TABLE_SINGLE_APP is not set
# CONFIG_PARTITION_TABLE_SINGLE_APP_LARGE is not set
# CONFIG_PARTITION_TABLE_TWO_OTA is not set
# CONFIG_PARTITION_TABLE_TWO_OTA_LARGE is not set
CONFIG_PARTITION_TABLE_CUSTOM_FILENAME="partitions.csv"
CONFIG_LV_COLOR_DEPTH_16=y
CONFIG_LV_COLOR_DEPTH=16
CONFIG_LV_COLOR_16_SWAP=y
CONFIG_LV_FONT_MONTSERRAT_28=y
CONFIG_SC_LED_STRIP_GPIO=8
```

## firmware/audio/main/Kconfig.projbuild
```kconfig
menu "SleepCube M2 validation"

config SC_ENABLE_TOUCH_DEBUG_AUDIO
    bool "Enable touch-debug generated audio sources"
    default n
    help
        Adds volatile music/sine source selection and C3..C8 generated tones
        to the semantic UART endpoint. Development images only.

config SC_M2_ENDURANCE_BUILD
    bool "Build the finite 60-minute M2 endurance image"
    default n
    help
        Retains the explicit M2 endurance build identity. The R00 product and
        endurance profiles now both use a finite 60-minute default; this option
        does not create a runtime API for unbounded playback.

endmenu
```
